## config/boards/shields/steering_wheel/Kconfig.defconfig
```kconfig
if SHIELD_STEERING_WHEEL

config ZMK_KEYBOARD_NAME
    default "SteeringWheel"

endif
```

## config/boards/shields/steering_wheel/Kconfig.shield
```kconfig
config SHIELD_STEERING_WHEEL
    def_bool $(shields_list_contains,steering_wheel)
```

## drivers/kscan/Kconfig
```kconfig
DT_COMPAT_ZMK_KSCAN_ADC_JOYSTICK := zmk,kscan-adc-joystick

if KSCAN

config ZMK_KSCAN_ADC_JOYSTICK
    bool "ZMK ADC joystick + GPIO button kscan"
    default $(dt_compat_enabled,$(DT_COMPAT_ZMK_KSCAN_ADC_JOYSTICK))
    select ADC
    select GPIO
    help
      Reads two ADC joystick axes (VRx/VRy) and maps them to directional
      key positions, while also reading direct GPIO buttons.

endif # KSCAN
```

## dts/bindings/kscan/zmk,kscan-adc-joystick.yaml
```yaml
# Copyright (c) 2026
# SPDX-License-Identifier: MIT

description: ADC joystick + direct GPIO button keyboard scan controller

compatible: "zmk,kscan-adc-joystick"

include: kscan.yaml

properties:
  io-channels:
    type: phandle-array
    required: true
    description: |
      Two ADC channels in this order: VRx, VRy.

  button-gpios:
    type: phandle-array
    required: true
    description: |
      Direct digital buttons. These are mapped after the four joystick
      direction columns.

  button-column-offset:
    type: int
    default: 4
    description: |
      Column index where button-gpios start. Columns 0..3 are reserved for
      joystick directions in this order: UP, DOWN, LEFT, RIGHT.

  poll-period-ms:
    type: int
    default: 8
    description: Poll interval for ADC/buttons.

  center:
    type: int
    default: 2048
    description: Joystick center value in raw ADC counts.

  deadzone:
    type: int
    default: 450
    description: Raw ADC distance from center before a direction activates.

  hysteresis:
    type: int
    default: 120
    description: Raw ADC hysteresis to reduce direction flicker near thresholds.

  invert-x:
    type: boolean
    description: Invert horizontal direction mapping.

  invert-y:
    type: boolean
    description: Invert vertical direction mapping.
```
