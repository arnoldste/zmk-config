/ {
  keymap {
    compatible = "zmk,keymap";

    default_layer {
      bindings = <
        &kp UP
        &kp DOWN
        &kp LEFT
        &kp RIGHT
        &kp ENTER
        &kp N1
        &kp N2
        &kp N3
        &kp N4
        &kp N5
        &kp N6
      >;
    };
  };
};