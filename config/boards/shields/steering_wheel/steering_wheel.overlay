#include <dt-bindings/zmk/matrix_transform.h>

/ {
  chosen {
    zmk,kscan = &kscan0;
    zmk,matrix-transform = &default_transform;
  };

  kscan0: kscan0 {
    compatible = "zmk,kscan-gpio-direct";
    wakeup-source;

    input-gpios = <
      &gpio1 15 (GPIO_PULL_UP | GPIO_ACTIVE_LOW)
    >;
  };

  default_transform: keymap_transform_0 {
    compatible = "zmk,matrix-transform";
    columns = <1>;
    rows = <1>;
    map = <
      RC(0,0)
    >;
  };
};
